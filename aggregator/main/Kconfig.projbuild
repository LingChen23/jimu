## aggregator/main/Kconfig.projbuild
```kconfig
menu "SmartBlock three-link aggregator"

    config SMARTBLOCK_AGGREGATOR_UART_BAUD
        int "Gateway UART baud rate (all three links)"
        default 921600

    config SMARTBLOCK_AGGREGATOR_UART_RX_BUFFER_SIZE
        int "Per-link UART RX driver buffer size"
        range 4096 65536
        default 16384

    config SMARTBLOCK_AGGREGATOR_UART_TX_BUFFER_SIZE
        int "Per-link UART command TX driver buffer size"
        range 1024 16384
        default 4096

    config SMARTBLOCK_AGGREGATOR_LINK_QUEUE_DEPTH
        int "Per-link validated-frame queue depth"
        range 16 256
        default 64

    config SMARTBLOCK_AGGREGATOR_USB_QUEUE_DEPTH
        int "Merged USB output queue depth"
        range 64 1024
        default 256

    config SMARTBLOCK_AGGREGATOR_MERGE_BURST
        int "Maximum frames taken from one link per merge pass"
        range 1 16
        default 4
        help
            A bounded burst prevents one busy or recovering gateway from
            starving the other two links.

    config SMARTBLOCK_AGGREGATOR_A_UART_PORT
        int "Gateway A UART controller"
        range 0 2
        default 1

    config SMARTBLOCK_AGGREGATOR_A_TX_GPIO
        int "Gateway A: aggregator TX GPIO (to gateway RX)"
        range 0 48
        default 17

    config SMARTBLOCK_AGGREGATOR_A_RX_GPIO
        int "Gateway A: aggregator RX GPIO (from gateway TX)"
        range 0 48
        default 18

    config SMARTBLOCK_AGGREGATOR_B_UART_PORT
        int "Gateway B UART controller"
        range 0 2
        default 2

    config SMARTBLOCK_AGGREGATOR_B_TX_GPIO
        int "Gateway B: aggregator TX GPIO (to gateway RX)"
        range 0 48
        default 15

    config SMARTBLOCK_AGGREGATOR_B_RX_GPIO
        int "Gateway B: aggregator RX GPIO (from gateway TX)"
        range 0 48
        default 16

    config SMARTBLOCK_AGGREGATOR_C_UART_PORT
        int "Gateway C UART controller"
        range 0 2
        default 0

    config SMARTBLOCK_AGGREGATOR_C_TX_GPIO
        int "Gateway C: aggregator TX GPIO (to gateway RX)"
        range 0 48
        default 5

    config SMARTBLOCK_AGGREGATOR_C_RX_GPIO
        int "Gateway C: aggregator RX GPIO (from gateway TX)"
        range 0 48
        default 6

endmenu
```

## aggregator/sdkconfig.defaults
```kconfig
# Board: LCKFB ESP32-S3 with ESP32-S3-WROOM-1-N16R8.
CONFIG_IDF_TARGET="esp32s3"
CONFIG_ESPTOOLPY_FLASHSIZE_16MB=y

# The aggregator has no BLE role and never initializes the Wi-Fi driver.
CONFIG_BT_ENABLED=n

# Native USB Serial/JTAG is the binary PC business channel.
CONFIG_ESP_CONSOLE_UART_DEFAULT=n
CONFIG_ESP_CONSOLE_UART_CUSTOM=n
CONFIG_ESP_CONSOLE_NONE=y
CONFIG_ESP_CONSOLE_SECONDARY_NONE=y
CONFIG_BOOTLOADER_LOG_LEVEL_NONE=y
CONFIG_BOOTLOADER_LOG_LEVEL=0
CONFIG_LOG_DEFAULT_LEVEL_NONE=y
CONFIG_LOG_DEFAULT_LEVEL=0
CONFIG_LOG_MAXIMUM_LEVEL=0

# Three independent full-duplex gateway links.
CONFIG_SMARTBLOCK_AGGREGATOR_UART_BAUD=921600
CONFIG_SMARTBLOCK_AGGREGATOR_UART_RX_BUFFER_SIZE=16384
CONFIG_SMARTBLOCK_AGGREGATOR_UART_TX_BUFFER_SIZE=4096
CONFIG_SMARTBLOCK_AGGREGATOR_LINK_QUEUE_DEPTH=64
CONFIG_SMARTBLOCK_AGGREGATOR_USB_QUEUE_DEPTH=256
CONFIG_SMARTBLOCK_AGGREGATOR_MERGE_BURST=4

# Gateway A -> devices 1..4.
CONFIG_SMARTBLOCK_AGGREGATOR_A_UART_PORT=1
CONFIG_SMARTBLOCK_AGGREGATOR_A_TX_GPIO=17
CONFIG_SMARTBLOCK_AGGREGATOR_A_RX_GPIO=18

# Gateway B -> devices 5..8.
CONFIG_SMARTBLOCK_AGGREGATOR_B_UART_PORT=2
CONFIG_SMARTBLOCK_AGGREGATOR_B_TX_GPIO=15
CONFIG_SMARTBLOCK_AGGREGATOR_B_RX_GPIO=16

# Gateway C -> devices 9..12. UART0 is remapped away from the disabled console.
CONFIG_SMARTBLOCK_AGGREGATOR_C_UART_PORT=0
CONFIG_SMARTBLOCK_AGGREGATOR_C_TX_GPIO=5
CONFIG_SMARTBLOCK_AGGREGATOR_C_RX_GPIO=6
```

## ble_gateway/main/Kconfig.projbuild
```kconfig
menu "SmartBlock BLE gateway"

    choice SMARTBLOCK_GATEWAY_PROFILE
        prompt "Gateway device group"
        default SMARTBLOCK_GATEWAY_PROFILE_A
        help
            One source project builds three gateway firmware variants.
            Each variant owns a fixed gateway ID and four nRF device slots.

        config SMARTBLOCK_GATEWAY_PROFILE_A
            bool "Gateway A: devices 1-4"

        config SMARTBLOCK_GATEWAY_PROFILE_B
            bool "Gateway B: devices 5-8"

        config SMARTBLOCK_GATEWAY_PROFILE_C
            bool "Gateway C: devices 9-12"
    endchoice

    choice SMARTBLOCK_GATEWAY_TRANSPORT
        prompt "Business-channel transport"
        default SMARTBLOCK_GATEWAY_TRANSPORT_USB
        help
            USB keeps the existing direct-to-PC gateway mode. UART sends and
            receives the same COBS + CRC32 frames through an ESP32-S3
            aggregator.

        config SMARTBLOCK_GATEWAY_TRANSPORT_USB
            bool "Native USB Serial/JTAG"

        config SMARTBLOCK_GATEWAY_TRANSPORT_UART
            bool "UART to SmartBlock aggregator"
    endchoice

    if SMARTBLOCK_GATEWAY_TRANSPORT_UART

        config SMARTBLOCK_GATEWAY_UART_PORT
            int "UART controller"
            range 0 2
            default 1

        config SMARTBLOCK_GATEWAY_UART_BAUD
            int "UART baud rate"
            default 921600

        config SMARTBLOCK_GATEWAY_UART_TX_GPIO
            int "UART TX GPIO"
            range 0 48
            default 17

        config SMARTBLOCK_GATEWAY_UART_RX_GPIO
            int "UART RX GPIO"
            range 0 48
            default 18

        config SMARTBLOCK_GATEWAY_UART_RX_BUFFER_SIZE
            int "UART RX driver buffer size"
            range 1024 65536
            default 16384

        config SMARTBLOCK_GATEWAY_UART_TX_BUFFER_SIZE
            int "UART TX driver buffer size"
            range 1024 65536
            default 32768

    endif

endmenu
```
